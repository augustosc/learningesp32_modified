## _5_working_with_c/_5_1_structure_and_pointer_primer/sdkconfig.defaults
```kconfig
#
# Serial flasher config
#

CONFIG_ESPTOOLPY_FLASHMODE_QIO=y

CONFIG_ESPTOOLPY_FLASH_SAMPLE_MODE_STR=y
CONFIG_ESPTOOLPY_FLASHMODE="qio"
CONFIG_ESPTOOLPY_FLASHFREQ_80M=y

CONFIG_ESPTOOLPY_FLASHFREQ="80m"

CONFIG_ESPTOOLPY_FLASHSIZE_4MB=y

CONFIG_ESPTOOLPY_FLASHSIZE="4MB"

CONFIG_ESPTOOLPY_BEFORE_RESET=y

CONFIG_ESPTOOLPY_BEFORE="default_reset"
CONFIG_ESPTOOLPY_AFTER_RESET=y

CONFIG_ESPTOOLPY_AFTER="hard_reset"
CONFIG_ESPTOOLPY_MONITOR_BAUD=115200

# end of Serial flasher config
```
